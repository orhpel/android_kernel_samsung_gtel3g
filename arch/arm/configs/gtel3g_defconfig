## arch/arm/configs/lephro_gtelwifi_defconfig
```kconfig
# CONFIG_ARM_PATCH_PHYS_VIRT is not set
CONFIG_PHYS_OFFSET=0x80000000
CONFIG_SYSVIPC=y
CONFIG_AUDIT=y
CONFIG_NO_HZ=y
CONFIG_HIGH_RES_TIMERS=y
CONFIG_IKCONFIG=y
CONFIG_IKCONFIG_PROC=y
CONFIG_LOG_BUF_SHIFT=18
CONFIG_CGROUPS=y
CONFIG_CGROUP_FREEZER=y
CONFIG_CGROUP_CPUACCT=y
CONFIG_RESOURCE_COUNTERS=y
CONFIG_MEMCG=y
CONFIG_CGROUP_SCHED=y
CONFIG_RT_GROUP_SCHED=y
CONFIG_BLK_DEV_INITRD=y
CONFIG_RD_LZMA=y
CONFIG_CC_OPTIMIZE_FOR_SIZE=y
CONFIG_PANIC_TIMEOUT=5
CONFIG_SYSCTL_SYSCALL=y
CONFIG_KALLSYMS_ALL=y
CONFIG_EMBEDDED=y
# CONFIG_VM_EVENT_COUNTERS is not set
# CONFIG_SLUB_DEBUG is not set
CONFIG_MODULES=y
CONFIG_MODULE_UNLOAD=y
CONFIG_MODVERSIONS=y
# CONFIG_LBDAF is not set
# CONFIG_BLK_DEV_BSG is not set
CONFIG_PARTITION_ADVANCED=y
# CONFIG_BLOCK_SUPPORT_STLOG is not set
# CONFIG_IOSCHED_CFQ is not set
CONFIG_ARCH_SC=y
CONFIG_ARCH_SCX30G2=y
CONFIG_MACH_SCX35_DT=y
CONFIG_ADIE_SC2723S=y
CONFIG_LDOGEN0_VCCQ=y
CONFIG_MACH_GTELWIFI=y
CONFIG_SPRD_VIBRATOR_2723=y
CONFIG_EIRQ_NUM=64
CONFIG_PIN_POWER_DOMAIN_SWITCH=y
CONFIG_SPRD_CPU_DYNAMIC_HOTPLUG=y
CONFIG_SIPC_WCDMA=y
CONFIG_BUS_MONITOR=y
CONFIG_EAR_LOW_LEVEL_DETECT=y
CONFIG_GPS_BCM47520=y
CONFIG_SAMSUNG_PRODUCT_SHIP=y
# CONFIG_SWP_EMULATE is not set
CONFIG_SMP=y
# CONFIG_SMP_ON_UP is not set
CONFIG_SCHED_MC=y
CONFIG_PREEMPT=y
CONFIG_THUMB2_KERNEL=y
CONFIG_HIGHMEM=y
CONFIG_PER_THREAD_VMA_CACHE=y
CONFIG_ZSMALLOC=y
CONFIG_PGTABLE_MAPPING=y
# CONFIG_SWAP_ENABLE_READAHEAD is not set
CONFIG_SECCOMP=y
CONFIG_ARM_FLUSH_CONSOLE_ON_RESTART=y
CONFIG_USE_OF=y
CONFIG_ZBOOT_ROM_TEXT=0x0
CONFIG_ZBOOT_ROM_BSS=0x0
CONFIG_CMDLINE="androidboot.hardware=sc8830"
CONFIG_CMDLINE_EXTEND=y
CONFIG_CPU_FREQ=y
CONFIG_CPU_FREQ_LIMIT=y
CONFIG_CPU_FREQ_DEFAULT_GOV_INTERACTIVE=y
CONFIG_CPU_FREQ_GOV_PERFORMANCE=y
CONFIG_SCX35_1300MHZ=y
CONFIG_CPU_IDLE=y
# CONFIG_CORE_DUMP_DEFAULT_ELF_HEADERS is not set
CONFIG_WAKELOCK=y
CONFIG_CPU_FREQ_LIMIT_USERSPACE=y
CONFIG_PM_AUTOSLEEP=y
CONFIG_PM_RUNTIME=y
CONFIG_SUSPEND_TIME=y
CONFIG_NET=y
CONFIG_PACKET=y
CONFIG_UNIX=y
CONFIG_XFRM_USER=y
CONFIG_NET_KEY=y
CONFIG_INET=y
CONFIG_IP_MULTICAST=y
CONFIG_IP_ADVANCED_ROUTER=y
CONFIG_IP_MULTIPLE_TABLES=y
CONFIG_NET_IPGRE_DEMUX=y
CONFIG_INET_ESP=y
# CONFIG_INET_LRO is not set
CONFIG_TCP_CONG_ADVANCED=y
CONFIG_TCP_CONG_BIC=y
CONFIG_DEFAULT_BIC=y
CONFIG_IPV6=y
CONFIG_IPV6_PRIVACY=y
CONFIG_IPV6_ROUTER_PREF=y
CONFIG_IPV6_ROUTE_INFO=y
CONFIG_IPV6_OPTIMISTIC_DAD=y
CONFIG_INET6_AH=y
CONFIG_INET6_ESP=y
CONFIG_INET6_IPCOMP=y
CONFIG_IPV6_TUNNEL=y
CONFIG_IPV6_MULTIPLE_TABLES=y
CONFIG_IPV6_SUBTREES=y
CONFIG_NETFILTER=y
CONFIG_NF_CONNTRACK=y
CONFIG_NF_CONNTRACK_EVENTS=y
CONFIG_NF_CT_PROTO_DCCP=y
CONFIG_NF_CT_PROTO_SCTP=y
CONFIG_NF_CT_PROTO_UDPLITE=y
CONFIG_NF_CONNTRACK_FTP=y
CONFIG_NF_CONNTRACK_PPTP=y
CONFIG_NF_CONNTRACK_TFTP=y
CONFIG_NF_CT_NETLINK=y
CONFIG_NETFILTER_TPROXY=y
CONFIG_NETFILTER_XT_TARGET_CLASSIFY=y
CONFIG_NETFILTER_XT_TARGET_CONNMARK=y
CONFIG_NETFILTER_XT_TARGET_IDLETIMER=y
CONFIG_NETFILTER_XT_TARGET_MARK=y
CONFIG_NETFILTER_XT_TARGET_NFLOG=y
CONFIG_NETFILTER_XT_TARGET_NFQUEUE=y
CONFIG_NETFILTER_XT_TARGET_TPROXY=y
CONFIG_NETFILTER_XT_TARGET_TRACE=y
CONFIG_NETFILTER_XT_TARGET_TCPMSS=y
CONFIG_NETFILTER_XT_MATCH_COMMENT=y
CONFIG_NETFILTER_XT_MATCH_CONNLIMIT=y
CONFIG_NETFILTER_XT_MATCH_CONNMARK=y
CONFIG_NETFILTER_XT_MATCH_CONNTRACK=y
CONFIG_NETFILTER_XT_MATCH_HASHLIMIT=y
CONFIG_NETFILTER_XT_MATCH_HELPER=y
CONFIG_NETFILTER_XT_MATCH_IPRANGE=y
CONFIG_NETFILTER_XT_MATCH_LENGTH=y
CONFIG_NETFILTER_XT_MATCH_LIMIT=y
CONFIG_NETFILTER_XT_MATCH_MAC=y
CONFIG_NETFILTER_XT_MATCH_MARK=y
CONFIG_NETFILTER_XT_MATCH_POLICY=y
CONFIG_NETFILTER_XT_MATCH_PKTTYPE=y
CONFIG_NETFILTER_XT_MATCH_QTAGUID=y
CONFIG_NETFILTER_XT_MATCH_QUOTA=y
CONFIG_NETFILTER_XT_MATCH_QUOTA2=y
CONFIG_NETFILTER_XT_MATCH_QUOTA2_LOG=y
CONFIG_NETFILTER_XT_MATCH_SOCKET=y
CONFIG_NETFILTER_XT_MATCH_STATE=y
CONFIG_NETFILTER_XT_MATCH_STATISTIC=y
CONFIG_NETFILTER_XT_MATCH_STRING=y
CONFIG_NETFILTER_XT_MATCH_TIME=y
CONFIG_NETFILTER_XT_MATCH_U32=y
CONFIG_NF_CONNTRACK_IPV4=y
CONFIG_IP_NF_IPTABLES=y
CONFIG_IP_NF_MATCH_AH=y
CONFIG_IP_NF_MATCH_ECN=y
CONFIG_IP_NF_MATCH_TTL=y
CONFIG_IP_NF_FILTER=y
CONFIG_IP_NF_TARGET_REJECT=y
CONFIG_IP_NF_TARGET_REJECT_SKERR=y
CONFIG_NF_NAT_IPV4=y
CONFIG_IP_NF_TARGET_MASQUERADE=y
CONFIG_IP_NF_TARGET_NETMAP=y
CONFIG_IP_NF_TARGET_REDIRECT=y
CONFIG_IP_NF_MANGLE=y
CONFIG_IP_NF_RAW=y
CONFIG_IP_NF_ARPTABLES=y
CONFIG_IP_NF_ARPFILTER=y
CONFIG_IP_NF_ARP_MANGLE=y
CONFIG_NF_CONNTRACK_IPV6=y
CONFIG_IP6_NF_IPTABLES=y
CONFIG_IP6_NF_FILTER=y
CONFIG_IP6_NF_TARGET_REJECT=y
CONFIG_IP6_NF_TARGET_REJECT_SKERR=y
CONFIG_IP6_NF_MANGLE=y
CONFIG_IP6_NF_RAW=y
CONFIG_L2TP=y
CONFIG_NET_SCHED=y
CONFIG_NET_SCH_HTB=y
CONFIG_NET_CLS_U32=y
CONFIG_NET_EMATCH=y
CONFIG_NET_EMATCH_U32=y
CONFIG_NET_CLS_ACT=y
CONFIG_CFG80211=y
CONFIG_NL80211_TESTMODE=y
CONFIG_WIRELESS_EXT_SYSFS=y
CONFIG_CFG80211_ALLOW_RECONNECT=y
CONFIG_RFKILL=y
CONFIG_RFKILL_REGULATOR=y
CONFIG_EXTRA_FIRMWARE="melfas/KANAS_NEW_TSP_FW.mfsb"
CONFIG_BATTERY_SAMSUNG=y
CONFIG_BATTERY_SWELLING=y
CONFIG_VBAT_CHECK=y
CONFIG_CHARGER_SMB358=y
CONFIG_BLK_DEV_LOOP=y
CONFIG_UID_STAT=y
CONFIG_BCM_BT_RFKILL=y
CONFIG_BCM_BT_LPM=y
CONFIG_SPRD_CPROC=y
# CONFIG_MDBG_SDIO is not set
# CONFIG_MDBG_RING is not set
CONFIG_RAID_ATTRS=y
CONFIG_SCSI=y
CONFIG_SCSI_TGT=y
CONFIG_BLK_DEV_SD=y
CONFIG_CHR_DEV_SG=y
CONFIG_SCSI_MULTI_LUN=y
CONFIG_SCSI_SCAN_ASYNC=y
CONFIG_SCSI_DH=y
CONFIG_MD=y
CONFIG_BLK_DEV_DM=y
CONFIG_DM_CRYPT=y
CONFIG_NETDEVICES=y
CONFIG_TUN=y
# CONFIG_ETHERNET is not set
CONFIG_PPP=y
CONFIG_WIFI_CONTROL_FUNC=y
CONFIG_BCM4343=y
CONFIG_BCMDHD_FW_PATH="/vendor/etc/wifi/bcmdhd_sta.bin"
CONFIG_BCMDHD_NVRAM_PATH="/vendor/etc/wifi/nvram_net.txt"
CONFIG_BROADCOM_WIFI_RESERVED_MEM=y
CONFIG_WIFI_BROADCOM_COB=y
# CONFIG_SC2331_MEM_ALLOC is not set
CONFIG_INPUT_MATRIXKMAP=y
# CONFIG_INPUT_MOUSEDEV is not set
CONFIG_INPUT_EVDEV=y
# CONFIG_KEYBOARD_ATKBD is not set
CONFIG_KEYBOARD_SC=y
CONFIG_SUPPORT_TWOKEY_RESET=y
# CONFIG_INPUT_MOUSE is not set
CONFIG_INPUT_TOUCHSCREEN=y
CONFIG_TOUCHSCREEN_ZT7554_TS=y
CONFIG_INPUT_MISC=y
CONFIG_INPUT_UINPUT=y
CONFIG_INPUT_GPIO=y
CONFIG_INPUT_HEADSET_SPRD_SC2723=y
# CONFIG_SERIO is not set
# CONFIG_VT is not set
# CONFIG_LEGACY_PTYS is not set
CONFIG_SERIAL_SPRD_UART=y
CONFIG_SERIAL_SPRD_UART_CONSOLE=y
# CONFIG_HW_RANDOM is not set
CONFIG_I2C=y
CONFIG_I2C_CHARDEV=y
CONFIG_I2C_GPIO=y
CONFIG_I2C_RESUME_EARLY=y
CONFIG_I2C_5_CLOCK_TREE_BUG=y
CONFIG_SPI=y
CONFIG_SPI_SCX35=y
CONFIG_GPIO_SYSFS=y
CONFIG_SEC_GPIO_DVS=y
CONFIG_POWER_SUPPLY=y
# CONFIG_HWMON is not set
CONFIG_THERMAL=y
CONFIG_THERMAL_SC2713S=y
CONFIG_WATCHDOG=y
CONFIG_SPRD_WATCHDOG_SYS=y
CONFIG_EXTCON_SAMSUNG=y
CONFIG_EXTCON_SM5504=y
CONFIG_REGULATOR=y
CONFIG_REGULATOR_FIXED_VOLTAGE=y
CONFIG_MEDIA_SUPPORT=y
CONFIG_VIDEO_GSP_SPRD=y
CONFIG_VIDEO_DCAM_SPRD=y
CONFIG_SENSOR_OUTPUT_RAW=y
CONFIG_MEDIA_CAMERA_SUPPORT=y
CONFIG_V4L_PLATFORM_DRIVERS=y
CONFIG_SOC_CAMERA=y
CONFIG_ION=y
CONFIG_ION_SPRD=y
CONFIG_SPRD_IOMMU=y
CONFIG_FB=y
CONFIG_FB_SCX30G=y
CONFIG_SPRD_FB_SIZE=6
CONFIG_FB_LCD_OVERLAY_SUPPORT=y
CONFIG_FB_DYNAMIC_FREQ_SCALING=y
CONFIG_LCD_ESD_RECOVERY=y
CONFIG_LCD_ESD_RECOVERY_BY_TSP=y
CONFIG_LCD_MIPI_CONTINOUS_CLK=y
CONFIG_SPRDFB_GEN_PANEL=y
CONFIG_BACKLIGHT_LCD_SUPPORT=y
# CONFIG_LCD_CLASS_DEVICE is not set
CONFIG_LCD_GENERIC=y
CONFIG_GEN_PANEL_TFT=y
CONFIG_GEN_PANEL_BACKLIGHT=y
CONFIG_BACKLIGHT_SPRD_PWM=y
CONFIG_BACKLIGHT_CLASS_DEVICE=y
# CONFIG_BACKLIGHT_GENERIC is not set
CONFIG_BACKLIGHT_RT8555=y
CONFIG_SOUND=y
CONFIG_SND=y
CONFIG_SND_SPRD_SAUDIO=y
CONFIG_SND_USB_AUDIO=y
CONFIG_SND_SOC=y
CONFIG_SND_SOC_SPRD=y
CONFIG_SND_SOC_SPRD_VBC_R2P0_SPRD_CODEC_V4=y
CONFIG_SND_SOC_SPRD_I2S_V0_NULL_CODEC=y
CONFIG_SND_SOC_SPRD_AUDIO_BUFFER_USE_IRAM=y
CONFIG_SND_SOC_SPRD_VBC_SRC_OPEN=y
CONFIG_SND_SOC_SPRD_AUDIO_USE_INTER_HP_PA_V4=y
CONFIG_SND_SOC_SPRD_CODEC_NO_HP_POP=y
CONFIG_SND_SOC_SPRD_HP_POP_DELAY_TIME=0
CONFIG_HID_BATTERY_STRENGTH=y
CONFIG_HIDRAW=y
CONFIG_UHID=y
CONFIG_HID_KEYTOUCH=y
CONFIG_HID_SYNAPTICS_BT=y
CONFIG_HID_SENSOR_HUB=y
CONFIG_USB=y
CONFIG_USB_ANNOUNCE_NEW_DEVICES=y
CONFIG_USB_STORAGE=y
CONFIG_USB_HOST_NOTIFY=y
CONFIG_USB_NOTIFY_LAYER=y
CONFIG_USB_NOTIFIER=y
CONFIG_USB_STORAGE_DETECT=y
CONFIG_USB_EXTERNAL_DETECT=y
CONFIG_USB_SERIAL=y
CONFIG_USB_SERIAL_PL2303=y
CONFIG_USB_OTG_WAKELOCK=y
CONFIG_USB_GADGET=y
CONFIG_USB_GADGET_VBUS_DRAW=500
CONFIG_USB_GADGET_SPRD_DWC=y
CONFIG_USB_G_ANDROID=y
CONFIG_USB_G_ANDROID_SAMSUNG_COMPOSITE=y
CONFIG_USB_CORE_IP_293A=y
CONFIG_MMC=y
# CONFIG_MMC_SUPPORT_STLOG is not set
CONFIG_MMC_UNSAFE_RESUME=y
CONFIG_MMC_BLOCK_MINORS=32
# CONFIG_SDIO_CHANNEL is not set
CONFIG_SDIO_CARD=y
CONFIG_MMC_SDHCI=y
CONFIG_MMC_SDHCI_SPRD=y
CONFIG_NEW_LEDS=y
CONFIG_LEDS_CLASS=y
CONFIG_SWITCH=y
CONFIG_SWITCH_GPIO=y
CONFIG_RTC_CLASS=y
CONFIG_RTC_DRV_SPRD=y
CONFIG_RTC_START_YEAR=2014
CONFIG_STAGING=y
CONFIG_ZRAM=y
CONFIG_ANDROID=y
CONFIG_ASHMEM=y
CONFIG_ANDROID_TIMED_GPIO=y
CONFIG_ANDROID_LOW_MEMORY_KILLER=y
CONFIG_ANDROID_LMK_ADJ_RBTREE=y
CONFIG_ANDROID_INTF_ALARM_DEV=y
CONFIG_SYNC=y
CONFIG_COMMON_CLK_DEBUG=y
CONFIG_HWSPINLOCK_SCI=y
# CONFIG_IOMMU_SUPPORT is not set
CONFIG_PM_DEVFREQ=y
CONFIG_DEVFREQ_GOV_SIMPLE_ONDEMAND=y
CONFIG_DEVFREQ_GOV_PERFORMANCE=y
CONFIG_DEVFREQ_GOV_POWERSAVE=y
CONFIG_DEVFREQ_GOV_USERSPACE=y
CONFIG_SPRD_SCX35_DMC_FREQ=y
CONFIG_SCX35_DMC_FREQ_AP=y
CONFIG_IIO=y
CONFIG_IIO_BUFFER=y
CONFIG_IIO_KFIFO_BUF=y
CONFIG_SIPC_SPIPE=y
CONFIG_SIPC_SETH=y
CONFIG_SIPC_STTY=y
CONFIG_SENSORS=y
CONFIG_SENSORS_K2HH=y
CONFIG_SENSORS_SX9500=y
CONFIG_SENSORS_SX9500_REGULATOR_ONOFF=y
CONFIG_SENSORS_SX9500_INIT_TOUCH_THRESHOLD=1700
CONFIG_SENSORS_SX9500_NORMAL_TOUCH_THRESHOLD=8
CONFIG_SENSORS_SX9500_DEFENCE_CODE_FOR_TA_NOISE=y
CONFIG_SPRD_IQ=y
# CONFIG_MALI400_PROFILING is not set
CONFIG_MALI_SHARED_INTERRUPTS=y
CONFIG_MALI_QUIET=y
CONFIG_ANDROID_BINDER_IPC=y
CONFIG_EXT4_FS=y
CONFIG_EXT4_FS_SECURITY=y
CONFIG_SDCARD_FS=y
# CONFIG_DNOTIFY is not set
CONFIG_FUSE_FS=y
CONFIG_VFAT_FS=y
# CONFIG_SPRD_DEBUG_FRAME is not set
CONFIG_TMPFS=y
CONFIG_ECRYPT_FS=y
CONFIG_WTL_ENCRYPTION_FILTER=y
CONFIG_F2FS_FS=y
CONFIG_F2FS_FS_SECURITY=y
# CONFIG_NETWORK_FILESYSTEMS is not set
CONFIG_NLS_CODEPAGE_437=y
CONFIG_NLS_ASCII=y
CONFIG_NLS_ISO8859_1=y
CONFIG_PRINTK_TIME=y
CONFIG_PRINTK_CORE_NUM=y
CONFIG_PRINTK_PROCESS=y
CONFIG_MAGIC_SYSRQ=y
# CONFIG_SCHED_DEBUG is not set
# CONFIG_DEBUG_PREEMPT is not set
CONFIG_RCU_CPU_STALL_TIMEOUT=60
CONFIG_FUNCTION_TRACER=y
CONFIG_TRACER_SNAPSHOT=y
CONFIG_RING_BUFFER_NONCACHE=y
# CONFIG_ARM_PTDUMP is not set
CONFIG_SEC_BSP=y
CONFIG_SEC_DEBUG=y
CONFIG_SEC_DEBUG_SCHED_LOG=y
CONFIG_SEC_DEBUG_SCHED_LOG_NONCACHED=y
CONFIG_SEC_DEBUG_TIMER_LOG=y
CONFIG_SEC_LOG=y
CONFIG_SEC_LOG_BUF_NOCACHE=y
CONFIG_SEC_LOG_LAST_KMSG=y
CONFIG_SEC_DEBUG_USER=y
CONFIG_SEC_DEBUG_REG_ACCESS=y
CONFIG_KEYS=y
CONFIG_SECURITY_DMESG_RESTRICT=y
CONFIG_SECURITY=y
CONFIG_SECURITY_NETWORK=y
CONFIG_SECURITY_SELINUX=y
# CONFIG_SECURITY_SELINUX_DEVELOP is not set
CONFIG_CRYPTO_NULL=y
CONFIG_CRYPTO_ARC4=y
CONFIG_CRYPTO_TWOFISH=y
CONFIG_CRYPTO_LZO=y
CONFIG_CRYPTO_ANSI_CPRNG=y
CONFIG_CRC_CCITT=y
```
